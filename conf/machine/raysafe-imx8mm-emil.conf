## conf/machine/raysafe-imx8mm-emil.conf
```bitbake
#@TYPE: Machine
#@NAME: RaySafe Emil
#@SOC: i.MX8MM
#@DESCRIPTION: Machine configuration for RaySafe Emil
#@MAINTAINER: jakob.lind@raysafe.com

include ../../meta-bsp-imx8mm/conf/machine/cpl-imx8m-mini.inc

KERNEL_DEVICETREE = "compulab/mcm-imx8m-mini.dtb "
KERNEL_DEVICETREE += "compulab/mcm-imx8m-mini-thermal.dtb "
KERNEL_DEVICETREE += "compulab/mcm-imx8m-mini-m4.dtb "
KERNEL_DEVICETREE += "compulab/sbc-mcm-imx8m-mini.dtb "
KERNEL_DEVICETREE += "compulab/sbc-mcm-imx8m-mini-rs485.dtb "

UBOOT_CONFIG ??= "sd"
UBOOT_CONFIG[sd] = "mcm-imx8m-mini_defconfig,sdcard"
UBOOT_CONFIG[mfgtool] = "mcm-imx8m-mini_defconfig"

# Set u-boot DTB
UBOOT_DTB_NAME = "mcm-imx8m-mini.dtb"


PLATFORM_FLAVOR_raysafe-imx8mm-emil = "mx8mmevk"
PLATFORM_FLAVOR_mcm-imx8m-mini = "mx8mmevk"
```
